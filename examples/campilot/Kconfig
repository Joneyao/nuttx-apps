## examples/campilot/Kconfig
```kconfig
#
# For a description of the syntax of this configuration file,
# see the file kconfig-language.txt in the NuttX tools repository.
#

config EXAMPLES_CAMPILOT
	bool "campilot MiMo AI example"
	default n
	select MIMO_CLIENT
	---help---
		NSH "campilot" command for MiMo AI interaction.
		Supports:
		  campilot once [prompt]  - capture image, send to vision API
		  campilot text <message> - send text query

if EXAMPLES_CAMPILOT

config EXAMPLES_CAMPILOT_PROGNAME
	string "Program name"
	default "campilot"

config EXAMPLES_CAMPILOT_PRIORITY
	int "Task priority"
	default 100

config EXAMPLES_CAMPILOT_STACKSIZE
	int "Stack size"
	default 8192

config EXAMPLES_CAMPILOT_AUTOTEST
	bool "Auto-run campilot test at boot"
	default n
	---help---
		Automatically spawn a campilot auto-test task from the board's
		bringup code (esp32p4-function-ev-board), which configures the
		network and sends a text query to MiMo once at boot.

		Disable this when the auto-test interferes with interactive NSH
		use. The "campilot" command itself remains available regardless
		of this setting.

endif # EXAMPLES_CAMPILOT
```
